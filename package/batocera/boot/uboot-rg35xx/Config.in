## package/batocera/boot/uboot-rg35xx/Config.in
```kconfig
config BR2_PACKAGE_UBOOT_RG35XX
    bool "uboot files for RG35XX"
    select BR2_TOOLCHAIN_OPTIONAL_LINARO_ARM
    help
        uboot files for RG35XX
```

## package/batocera/emulators/retroarch/libretro/libretro-bk/Config.in
```kconfig
config BR2_PACKAGE_LIBRETRO_BK
    bool "libretro-bk"
	depends on BR2_PACKAGE_RETROARCH
	depends on BR2_INSTALL_LIBSTDCPP
      help
        A emulator core Soviet (russian) Electronica BK series

	  http://www.libretro.com

comment "LIBRETRO_BK needs a toolchain w/ C++"
	depends on !BR2_INSTALL_LIBSTDCPP
```

## package/batocera/emulators/retroarch/libretro/libretro-cannonball/Config.in
```kconfig
config BR2_PACKAGE_LIBRETRO_CANNONBALL
    bool "libretro-cannonball"
    select BR2_PACKAGE_SDL2
    select BR2_PACKAGE_SDL2_MIXER
    select BR2_PACKAGE_LIBPNG
    select BR2_PACKAGE_ZLIB
      help
	Cannonball is an enhanced version of the seminal arcade racer OutRun designed by Yu Suzuki.

	https://github.com/kodi-game/game.libretro.cannonball
```

## package/batocera/emulators/retroarch/libretro/libretro-gme/Config.in
```kconfig
config BR2_PACKAGE_LIBRETRO_GME
    bool "libretro-gme"
	depends on BR2_PACKAGE_RETROARCH
	depends on BR2_INSTALL_LIBSTDCPP
      help
        A libretro core for blargg' Game Music Emu

	  http://www.libretro.com

comment "LIBRETRO_GME needs a toolchain w/ C++"
	depends on !BR2_INSTALL_LIBSTDCPP
```

## package/batocera/emulators/retroarch/libretro/libretro-meteor/Config.in
```kconfig
config BR2_PACKAGE_LIBRETRO_METEOR
    bool "libretro-meteor"
      help
	Meteor is a Nintendo Gameboy Advance emulator. 	

	https://github.com/libretro/meteor-libretro
```

## package/batocera/emulators/retroarch/libretro/libretro-supafaust/Config.in
```kconfig
config BR2_PACKAGE_LIBRETRO_SUPAFAUST
    bool "libretro-supafaust"
	depends on BR2_PACKAGE_RETROARCH
	depends on BR2_INSTALL_LIBSTDCPP
      help
        Snes9x - Portable Super Nintendo Entertainment System (TM) emulator http://www.snes9x.com

	  http://www.libretro.com

comment "LIBRETRO_SUPAFAUST needs a toolchain w/ C++"
	depends on !BR2_INSTALL_LIBSTDCPP
```

## package/batocera/emulators/retroarch/libretro/libretro-vm/Config.in
```kconfig
config BR2_PACKAGE_LIBRETRO_VM
    bool "libretro-vm"
	depends on BR2_PACKAGE_RETROARCH
	depends on BR2_INSTALL_LIBSTDCPP
      help
        A libretro core for Vapor Spec, a virtual game platform 
	with capabilities similar to 80s game consoles. This repo
	is contains the Windows/Linux implementation, some games,
	the compiler, assembler, and documentation.

	  http://www.libretro.com

comment "LIBRETRO_VM needs a toolchain w/ C++"
	depends on !BR2_INSTALL_LIBSTDCPP
```

## package/batocera/gpu/mali-g31-fbdev/Config.in
```kconfig
config BR2_PACKAGE_MALI_G31_FBDEV
	bool "mali-g31-fbdev"
	depends on BR2_aarch64
	select BR2_PACKAGE_HAS_LIBEGL
	select BR2_PACKAGE_HAS_LIBGLES
	select BR2_PACKAGE_HAS_LIBMALI
	
	help
	  Install the binary user-space components for the ARM Mali Bifrost G31 GPU
	  This package requires a kernel with the ARM Mali Bifrost G31 
	  GPU Kernel Drivers enabled.

if BR2_PACKAGE_MALI_G31_FBDEV

config BR2_PACKAGE_PROVIDES_LIBEGL
	default "mali-g31-fbdev"

config BR2_PACKAGE_PROVIDES_LIBGLES
	default "mali-g31-fbdev"

config BR2_PACKAGE_PROVIDES_LIBMALI
	default "mali-g31-fbdev"

endif

comment "mali-g31-fbdev"
```

## package/batocera/gpu/powervr-sgx544-driver/Config.in
```kconfig
config BR2_PACKAGE_POWERVR_SGX544_DRIVER
	bool "powervr-sgx544-driver"
	depends on BR2_arm
	select BR2_PACKAGE_HAS_LIBEGL
	select BR2_PACKAGE_HAS_LIBGLES
	
	help
	  Install the binary user-space components for the PowerVR SGX544
	  GPU. This package requires a kernel with the powervrkm 
	  GPU Kernel Drivers enabled.

if BR2_PACKAGE_POWERVR_SGX544_DRIVER

config BR2_PACKAGE_PROVIDES_LIBEGL
	default "powervr-sgx544-driver"

config BR2_PACKAGE_PROVIDES_LIBGLES
	default "powervr-sgx544-driver"

endif

comment "powervr-sgx544-driver"
```

## package/batocera/ports/openrct2/Config.in
```kconfig
config BR2_PACKAGE_OPENRCT2
	bool "OpenRCT2"
	select BR2_PACKAGE_SDL2
	select BR2_PACKAGE_SDL2_IMAGE
	help
	  OpenRCT2

	  https://github.com/OpenRCT2/OpenRCT2
```

## package/batocera/ports/openttd/Config.in
```kconfig
config BR2_PACKAGE_OPENTTD
	bool "OpenTTD"
	select BR2_PACKAGE_SDL2
	select BR2_PACKAGE_SDL2_IMAGE
	help
	  OpenTTD

	  https://github.com/OpenTTD/OpenTTD
```

## package/batocera/ports/spacecadet/Config.in
```kconfig
config BR2_PACKAGE_SPACECADET
	bool "Space Cadet Pinball"
	select BR2_PACKAGE_SDL2
	select BR2_PACKAGE_SDL2_IMAGE
	help
	  SpaceCadetPinball

 	  https://github.com/k4zmu2a/SpaceCadetPinball
```

## package/batocera/ports/vvvvvv/Config.in
```kconfig
config BR2_PACKAGE_VVVVVV
	bool "vvvvvv"
	depends on BR2_INSTALL_LIBSTDCPP
	select BR2_PACKAGE_SDL2
	help
	  VVVVVV

	  https://github.com/djyt/cannonball

comment "VVVVVV needs a toolchain w/ C++, and following libraries : sdl2, boost"
	depends on !BR2_INSTALL_LIBSTDCPP || !BR2_PACKAGE_SDL2 
```

## package/batocera/toolchain/toolchain-optional-linaro-arm/Config.in
```kconfig
config BR2_TOOLCHAIN_OPTIONAL_LINARO_ARM
	bool "toolchain-optional-linaro-arm"
	depends on BR2_HOSTARCH = "x86_64" || BR2_HOSTARCH = "x86"
	help
	  Toolchain for the ARM architecture that can be optionally used by packages at compile time, from
	  http://www.linaro.org/engineering/armv7/
```
